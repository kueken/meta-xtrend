## conf/machine/et9x00.conf
```bitbake
#@TYPE: Machine
#@NAME: Xtrend et9x00
#@DESCRIPTION: Machine configuration for the Xtrend et9x00

DISTRO_FEATURES_remove = "x11 wayland directfb"

SOC_FAMILY = "bcm7413"

MACHINE_FEATURES += "blindscan-dvbs"

require conf/machine/include/etxx00.inc
```
